/*
José Silva - nº 2222918
Nuno José - nº 2232152
IPLEIRIA - Instituto Politécnico de Leiria
ESTG - Escola Superior de Tecnologia e Gestão
LEAU - Licenciatura em Engenharia Automóvel
SEEV - Sistemas Elétricos e Eletrónicos de Veículos

Pretende-se neste trabalho prático a automatização dos médios do farol dianteiro de um veículo automóvel bem como a sua direção ao virar o volante e ainda controlo das outras luzes constituites de um farol, utilizando um sistema operativo de tempo real FreeRTOS.

LINK: (link do código do vídeo do youtube).
*/

#include "Arduino.h"
#include <stdio.h>
#include "freertos/FreeRTOS.h"
#include "freertos/task.h"
#include "esp_system.h"
#include "nvs_flash.h"
#include "esp_task_wdt.h"

// Biblioteca Servo
#include <ESP32Servo.h>

// Bibliotecas TFT
#include <SPI.h>
#include <Adafruit_GFX.h>
#include <Adafruit_ST7735.h>

// Definir Terminais Manete Esquerda
#define LED_FLASH_MAX 4
#define LED_MAX_BUTTON 15
#define LED_TEMP_LEFT 3
#define LED_TEMP_RIGHT 22
#define LED_FIX_LEFT 19
#define LED_FIX_RIGHT 21

// Definir Terminal Botão 4 Piscas
#define LED_EMERG 12

// Definir Terminais Manete Direita
#define LED_MIN_BUTTON 27
#define LED_MED_BUTTON 14
#define LED_AUTO_BUTTON 17

// Definir Terminais LEDs
#define LED_MIN 16
#define LED_MED 32
#define LED_MAX 33
#define LED_LEFT 13
#define LED_RIGHT 25

// Definir Terminais ADCs
#define ADC_LDR 36  // LDR
#define ADC_POT 35  // Potenciómetro
#define ADC_RESOLUTION 12

// Definir Terminal Servo
#define SERVO_SIGNAL 2

// Definir Terminais LCD
#define TFT_CS   05
#define TFT_DC   26
#define TFT_MOSI 23
#define TFT_SCLK 18
#define TFT_RST -1 // ligar ao 3V3

//Funções das Tarefas
void vTask_TFT ( void *pvParameters );
void vTask_MANETES ( void *pvParameters );
void vTask_LDR ( void *pvParameters );
void vTask_POT ( void *pvParameters );
void vTask_SERVO ( void *pvParameters );
void vTask_MINIMOS ( void *pvParameters );
void vTask_MEDIOS ( void *pvParameters );
void vTask_MAXIMOS ( void *pvParameters );
void vTask_PISCAS ( void *pvParameters);
void vTask_IDLE ( void *pvParameters );

// Função de Interrupção
static void IRAM_ATTR vExampleInterruptHandler( void );

//Imagens TFT
const uint16_t img_minimos[40*30]
{

	0x0000, 0x0000, 0x0000, 0x0000, 0x0000, 0x0000, 0x0000, 0x0000, 0x0000, 0x0000, 0x0000, 0x0000,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 0x0000,
	0x0000, 0x0000, 0x0000, 0x0000, 0x0000, 0x0000, 0x0000, 0x0000, 0x0000, 0x0000, 0x0000, 0x0000,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 0x0000,
	0x0000, 0x0000, 0x0000, 0x0000, 0x0000, 0x0000, 0x0000, 0x0000, 0x0000, 0x0000, 0x0000, 0x0000,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 0x0000,
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	0x0000, 0x0000, 0x0000, 0x0000, 0x0000, 0x0000, 0x0000, 0x0000, 0x0000, 0x0000, 0x0000, 0x0000,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 0x0000
};

const uint16_t img_medios[40*30]
{

	0x0000, 0x0000, 0x0000, 0x0000, 0x0000, 0x0000, 0x0000, 0x0000, 0x0000, 0x0000, 0x0000, 0x0000,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 0x0000,
	0x0000, 0x0000, 0x0000, 0x0000, 0x0000, 0x0000, 0x0000, 0x0000, 0x0000, 0x0000, 0x0000, 0x0000,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 0x0000,
	0x0000, 0x0000, 0x0000, 0x0000, 0x0000, 0x0000, 0x0000, 0x0000, 0x0000, 0x0000, 0x0000, 0x0000,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 0x0000,
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	0x0000, 0x0000, 0x0000, 0x0000, 0x0000, 0x0000, 0x0000, 0x0000, 0x0000, 0x0000, 0x0000, 0x0000,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 0x0000
};

const uint16_t img_maximos[40*30]
{

	0x0000, 0x0000, 0x0000, 0x0000, 0x0000, 0x0000, 0x0000, 0x0000, 0x0000, 0x0000, 0x0000, 0x0000,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 0x0000,
	0x0000, 0x0000, 0x0000, 0x0000, 0x0000, 0x0000, 0x0000, 0x0000, 0x0000, 0x0000, 0x0000, 0x0000,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 0x0000,
	0x0000, 0x0000, 0x0000, 0x0000, 0x0000, 0x0000, 0x0000, 0x0000, 0x0000, 0x0000, 0x0000, 0x0000,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 0x0000,
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	0x0000, 0x0000, 0x0000, 0x0000, 0x0000, 0x0000, 0x0000, 0x0000, 0x0000, 0x0000, 0x0000, 0x0000,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 0x0000
};

const uint16_t img_piscaesquerdo[40*30]
{

	0x0000, 0x0000, 0x0000, 0x0000, 0x0000, 0x0000, 0x0000, 0x0000, 0x0000, 0x0000, 0x0000, 0x0000,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 0x0000,
	0x0000, 0x0000, 0x0000, 0x0000, 0x0000, 0x0000, 0x0000, 0x0000, 0x0000, 0x0000, 0x0000, 0x0000,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 0x0000,
	0x0000, 0x0000, 0x0000, 0x0000, 0x0000, 0x0000, 0x0000, 0x0000, 0x0000, 0x0000, 0x0000, 0x0000,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 0x0000,
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	0x0000, 0x0000, 0x0000, 0x0000, 0x0000, 0x0000, 0x0000, 0x0000, 0x0000, 0x0000, 0x0000, 0x0000,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 0x0000
};

const uint16_t img_4piscas[40*30]
{

	0x0000, 0x0000, 0x0000, 0x0000, 0x0000, 0x0000, 0x0000, 0x0000, 0x0000, 0x0000, 0x0000, 0x0000,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 0x0000,
	0x0000, 0x0000, 0x0000, 0x0000, 0x0000, 0x0000, 0x0000, 0x0000, 0x0000, 0x0000, 0x0000, 0x0000,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 0x0000,
	0x0000, 0x0000, 0x0000, 0x0000, 0x0000, 0x0000, 0x0000, 0x0000, 0x0000, 0x0000, 0x0000, 0x0000,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 0x0000,
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	0x0000, 0x0000, 0x0000, 0x0000, 0x0000, 0x0000, 0x0000, 0x0000, 0x0000, 0x0000, 0x0000, 0x0000,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 0x0000
};

const uint16_t img_piscadireito[40*30]
{

	0x0000, 0x0000, 0x0000, 0x0000, 0x0000, 0x0000, 0x0000, 0x0000, 0x0000, 0x0000, 0x0000, 0x0000,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 0x0000,
	0x0000, 0x0000, 0x0000, 0x0000, 0x0000, 0x0000, 0x0000, 0x0000, 0x0000, 0x0000, 0x0000, 0x0000,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 0x0000,
	0x0000, 0x0000, 0x0000, 0x0000, 0x0000, 0x0000, 0x0000, 0x0000, 0x0000, 0x0000, 0x0000, 0x0000,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 0x0000,
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	0x0000, 0x0000, 0x0000, 0x0000, 0x0000, 0x0000, 0x0000, 0x0000, 0x0000, 0x0000, 0x0000, 0x0000,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 0x0000
};

// Função genérica para desenhar imagens
void drawImage(const uint16_t *img, int w, int h, int x, int y, Adafruit_ST7735 &tft)
{
    tft.startWrite();
    tft.setAddrWindow(x, y, w, h);
    for (int i = 0; i < w * h; i++)
    {

        uint16_t color = pgm_read_word(&img[i]);
        tft.pushColor(color);
    }

    tft.endWrite();
}

// Criar um objeto tft
Adafruit_ST7735 tft = Adafruit_ST7735(TFT_CS, TFT_DC, TFT_MOSI, TFT_SCLK, TFT_RST);

// Declaração Semáforos
SemaphoreHandle_t xCountingSemaphore, xMutex;

// Declaração Queues
QueueHandle_t xQueue_POT1, xQueue_POT2, xQueue_LDR, xQueue_Estado;

// Declaração de ID's
TaskHandle_t xTaskLDRHandle, xTaskMinimosHandle, xTaskMediosHandle, xTaskMaximosHandle, xTaskPiscasHandle;

// Estrutura de estado das luzes
typedef struct {
  bool minimos;
  bool medios;
  bool maximos;
  bool pisca_esq;
  bool pisca_dir;
  bool quatro_piscas;
} EstadoLuzes;


void setup()
{

	vTaskPrioritySet(NULL, configMAX_PRIORITIES - 1); // Garante que o setup é executado até ao fim

	Serial.begin(115200);

	// Configuração dos Pinos
	// Entradas (Manetes/Botão)
	pinMode(LED_MIN_BUTTON, INPUT_PULLUP);
	pinMode(LED_MED_BUTTON, INPUT_PULLUP);
	pinMode(LED_MAX_BUTTON, INPUT_PULLUP);
	pinMode(LED_AUTO_BUTTON, INPUT_PULLUP);
	pinMode(LED_FLASH_MAX, INPUT_PULLUP);
	pinMode(LED_TEMP_LEFT, INPUT_PULLUP);
	pinMode(LED_TEMP_RIGHT, INPUT_PULLUP);
	pinMode(LED_FIX_LEFT, INPUT_PULLUP);
	pinMode(LED_FIX_RIGHT, INPUT_PULLUP);
	pinMode(LED_EMERG, INPUT_PULLUP);

	// Saídas (LEDs)
	pinMode(LED_MIN, OUTPUT);
	pinMode(LED_MED, OUTPUT);
	pinMode(LED_MAX, OUTPUT);
	pinMode(LED_LEFT, OUTPUT);
	pinMode(LED_RIGHT, OUTPUT);
	digitalWrite(LED_MIN, LOW);
	digitalWrite(LED_MED, LOW);
    digitalWrite(LED_MAX, LOW);
    digitalWrite(LED_LEFT, LOW);
    digitalWrite(LED_RIGHT, LOW);

    // Interrupções
    attachInterrupt(digitalPinToInterrupt(LED_TEMP_RIGHT), &vExampleInterruptHandler, FALLING);
    attachInterrupt(digitalPinToInterrupt(LED_TEMP_LEFT), &vExampleInterruptHandler, FALLING);

    // Criação de Semáforos
    xCountingSemaphore = xSemaphoreCreateCounting(5, 0); // Semáforo Contador com 5 gives
    xMutex = xSemaphoreCreateMutex();

    // Criação de Queues
    xQueue_POT1 = xQueueCreate(1, sizeof(int)); // Para Servo
    xQueue_POT2 = xQueueCreate(1, sizeof(int)); // Para TFT
    xQueue_LDR = xQueueCreate(1, sizeof(int));  // Para Manetes
    xQueue_Estado = xQueueCreate(1, sizeof(EstadoLuzes)); // Para TFT

    // Criação de Tarefas
    xTaskCreatePinnedToCore( vTask_MANETES, "Task Manetes", 4096, NULL, 3, NULL, 1);
    xTaskCreatePinnedToCore( vTask_POT, "Task Potenciometro", 2048, NULL, 4, NULL, 1);
    xTaskCreatePinnedToCore( vTask_SERVO, "Task Servo", 4096, NULL, 4, NULL, 1);
    xTaskCreatePinnedToCore( vTask_IDLE, "Task Idle", 1024, NULL, 1, NULL, 1);
    xTaskCreatePinnedToCore( vTask_TFT, "Task TFT", 4096, NULL, 2, NULL, 1);
}

void vTask_TFT(void *pvParameters)
{
    int angulo = 0;
    int last_x = -1;
    int last_ang_display = -999;

    EstadoLuzes estadoAtual;
    EstadoLuzes estadoAnterior = {false, false, false, false, false, false};

    TickType_t xLastWakeTime;
    xLastWakeTime = xTaskGetTickCount();

    // Inicialização
    if (xSemaphoreTake(xMutex, portMAX_DELAY))
    {

        // Inicialização TFT
        tft.initR(INITR_BLACKTAB);
        tft.setRotation(0);
        tft.fillScreen(ST7735_BLACK);
    	tft.setTextColor(ST7735_WHITE);
    	tft.setTextSize(1);
    	tft.setCursor(0, 0);

    	// Barra horizontal
    	tft.drawFastHLine(10, 110, 108, ST7735_WHITE);

        xSemaphoreGive(xMutex);
    }

    for (;;)
    {

        // Atualização do estado das luzes
        if (xQueueReceive(xQueue_Estado, &estadoAtual, 0) == pdTRUE)
        {

            if (xSemaphoreTake(xMutex, 100))
            {
                // Mínimos
                if (estadoAtual.minimos && !estadoAnterior.minimos)
                {

                    drawImage(img_minimos, 40, 30, 0, 0, tft);
                }
                else if (!estadoAtual.minimos && estadoAnterior.minimos)
                {

                    tft.fillRect(0, 0, 40, 30, ST7735_BLACK);
                }

                // Médios
                if (estadoAtual.medios && !estadoAnterior.medios)
                {

                    drawImage(img_medios, 40, 30, 44, 0, tft);
                }
                else if (!estadoAtual.medios && estadoAnterior.medios)
                {

                    tft.fillRect(44, 0, 40, 30, ST7735_BLACK);
                }

                // Máximos
                if (estadoAtual.maximos && !estadoAnterior.maximos)
                {

                    drawImage(img_maximos, 40, 30, 88, 0, tft);
                }
                else if (!estadoAtual.maximos && estadoAnterior.maximos)
                {

                    tft.fillRect(88, 0, 40, 30, ST7735_BLACK);
                }

                // Pisca Esquerdo
                if (estadoAtual.pisca_esq && !estadoAnterior.pisca_esq)
                {

                    drawImage(img_piscaesquerdo, 40, 30, 0, 35, tft);
                } else if (!estadoAtual.pisca_esq && estadoAnterior.pisca_esq)
                {

                    tft.fillRect(0, 35, 40, 30, ST7735_BLACK);
                }

                // 4 Piscas
                if (estadoAtual.quatro_piscas && !estadoAnterior.quatro_piscas)
                {

                    drawImage(img_4piscas, 40, 30, 44, 35, tft);
                }
                else if (!estadoAtual.quatro_piscas && estadoAnterior.quatro_piscas)
                {

                    tft.fillRect(44, 35, 40, 30, ST7735_BLACK);
                }

                // Pisca Direito
                if (estadoAtual.pisca_dir && !estadoAnterior.pisca_dir)
                {

                    drawImage(img_piscadireito, 40, 30, 88, 35, tft);
                }
                else if (!estadoAtual.pisca_dir && estadoAnterior.pisca_dir)
                {

                    tft.fillRect(88, 35, 40, 30, ST7735_BLACK);
                }

                xSemaphoreGive(xMutex);

                estadoAnterior = estadoAtual;
            }
        }

        // Atualização do ângulo
        if (xQueueReceive(xQueue_POT2, &angulo, 0) == pdTRUE)
        {

        	int ang = angulo;

            if (ang < -45)
            	ang = -45;

            if (ang > 45)
            	ang = 45;

            int x = map(ang, -45, 45, 118, 10);

            if (xSemaphoreTake(xMutex, 100))
            {

                if (last_x >= 0 && last_x != x)
                {

                    tft.fillCircle(last_x, 110, 4, ST7735_BLACK);
                    tft.drawFastHLine(10, 110, 108, ST7735_WHITE);
                }

                tft.fillCircle(x, 110, 4, ST7735_WHITE);
                last_x = x;

                if (ang != last_ang_display)
                {

                    tft.fillRect(40, 130, 60, 20, ST7735_BLACK);
                    tft.setTextSize(1);
                    tft.setTextColor(ST7735_WHITE);
                    tft.setCursor(55, 130);
                    tft.print(ang);
                    last_ang_display = ang;
                }

                xSemaphoreGive(xMutex);
            }
        }

        vTaskDelay( 50 / portTICK_PERIOD_MS );
    }
}


void vTask_MANETES ( void *pvParameters )
{

	int valor_ldr = 1400;
	int modo_pisca = -1;
	int pisca_ativo = -1;

	EstadoLuzes estadoEnviar;

	TickType_t xLastWakeTime;
    xLastWakeTime = xTaskGetTickCount();

    Serial.println("Task Manetes a Correr");

    for (;;)
    {

    	// Manete Direita
        if (digitalRead(LED_AUTO_BUTTON) == 0)
        {

        	if (xTaskLDRHandle == NULL)
        	{

        		Serial.println("Modo Automatico ligado");
        		xTaskCreatePinnedToCore( vTask_LDR, "Task LDR", 2048, NULL, 2, &xTaskLDRHandle, 1);

        		if (xTaskMinimosHandle == NULL)
        		{

        			xTaskCreatePinnedToCore( vTask_MINIMOS, "Task Minimos", 1024, NULL, 4, &xTaskMinimosHandle, 1);
       			}
        	}

        	// Receber da Queue a luminosidade
        	xQueueReceive(xQueue_LDR, &valor_ldr, 100);

        	if (valor_ldr <= 1365)
        	{

        		if (xTaskMediosHandle == NULL)
        		{
        			Serial.println("Medios ligados");
        			xTaskCreatePinnedToCore( vTask_MEDIOS, "Task Medios", 1024, NULL, 4, &xTaskMediosHandle, 1);
       			}
        	}
        	else if (xTaskMediosHandle != NULL)
        	{

        		Serial.println("A eliminar Task Medios");

        		digitalWrite(LED_MED, LOW);
        		vTaskDelete(xTaskMediosHandle);

        		xTaskMediosHandle = NULL;
        	}
        }
        else if (digitalRead(LED_MIN_BUTTON) == 0)
       	{
        	if (xTaskMinimosHandle == NULL)
        	{
        		Serial.println("Minimos ligados");
        		xTaskCreatePinnedToCore( vTask_MINIMOS, "Task Minimos", 1024, NULL, 4, &xTaskMinimosHandle, 1);
        	}

        	if (xTaskLDRHandle != NULL)
        	{

        		Serial.println("A eliminar Task LDR");

        		vTaskDelete(xTaskLDRHandle);

        		xTaskLDRHandle = NULL;
       		}

        	if (xTaskMediosHandle != NULL)
        	{

        		Serial.println("A eliminar Task Medios");

        		digitalWrite(LED_MED, LOW);
        		vTaskDelete(xTaskMediosHandle);

        		xTaskMediosHandle = NULL;
        	}
       	}
        else if (digitalRead(LED_MED_BUTTON) == 0)
        {
        	if (xTaskMediosHandle == NULL)
        	{
        		Serial.println("Medios ligados");
        		xTaskCreatePinnedToCore( vTask_MEDIOS, "Task Medios", 1024, NULL, 4, &xTaskMediosHandle, 1);
        	}
        }
        else
        {

        	if (xTaskLDRHandle != NULL)
        	{

        		Serial.println("A eliminar Task LDR");

        		vTaskDelete(xTaskLDRHandle);

        		xTaskLDRHandle = NULL;
        	}

        	if (xTaskMinimosHandle != NULL)
        	{

        		Serial.println("A eliminar Task Minimos");

        		digitalWrite(LED_MIN, LOW);
        		vTaskDelete(xTaskMinimosHandle);

        		xTaskMinimosHandle = NULL;
        	}

        	if (xTaskMediosHandle != NULL)
        	{

        		Serial.println("A eliminar Task Medios");

        		digitalWrite(LED_MED, LOW);
        		vTaskDelete(xTaskMediosHandle);

        		xTaskMediosHandle = NULL;
        	}
        }


        // Manete Esquerda
        if (digitalRead(LED_MAX_BUTTON) == 0 && digitalRead(LED_MED) == 1)
        {

        	if (xTaskMaximosHandle == NULL)
        	{

        		Serial.println("Maximos ligados");
        		xTaskCreatePinnedToCore( vTask_MAXIMOS, "Task Maximos", 1024, NULL, 4, &xTaskMaximosHandle, 1);
        	}

        }
        else if (digitalRead(LED_FLASH_MAX) == 0)
        {

        	if (xTaskMaximosHandle == NULL)
        	{
        		Serial.println("Sinal de Luzes");
        		xTaskCreatePinnedToCore( vTask_MAXIMOS, "Task Maximos", 1024, NULL, 4, &xTaskMaximosHandle, 1);
        	}
        }

        else
        {

        	if (xTaskMaximosHandle != NULL)
        	{

        		Serial.println("A eliminar Task Maximos");

        		digitalWrite(LED_MAX, LOW);
        		vTaskDelete(xTaskMaximosHandle);

        		xTaskMaximosHandle = NULL;
        	}
        }

        modo_pisca = -1;


        if (digitalRead(LED_FIX_LEFT) == 0)
        {

        	modo_pisca = 0;
        }
        else if (digitalRead(LED_FIX_RIGHT) == 0)
        {

        	modo_pisca = 1;
        }
        else if (digitalRead(LED_TEMP_LEFT) == 0)
        {

        	if (digitalRead(LED_FIX_LEFT) == 0)
        	{

        		modo_pisca = 0;
        	}
        	else
        	{

        		modo_pisca = 2;
        	}
        }
        else if (digitalRead(LED_TEMP_RIGHT) == 0)
        {

        	if (digitalRead(LED_FIX_RIGHT) == 0)
        	{

        		modo_pisca = 1;
        	}
        	else
        	{

        		modo_pisca = 3;
        	}
        }
        else if (digitalRead(LED_EMERG) == 0)
        {

        	modo_pisca = 4;
        }

        if (modo_pisca != -1)
        {
        	if (xTaskPiscasHandle == NULL)
        	{

        		Serial.print("Piscas ON Modo: ");
        		Serial.println(modo_pisca);

        		if (modo_pisca == 0)
        			Serial.println("Piscas Fixo Esquerdo ligado");
        		else if (modo_pisca == 1)
        			Serial.println("Piscas Fixo Direito ligado");
        		else if (modo_pisca == 2)
        			Serial.println("Piscas Temporario Esquerdo ligado");
        		else if (modo_pisca == 3)
        			Serial.println("Piscas Temporario Direito ligado");
        		else if (modo_pisca == 4)
        			Serial.println("4 Piscas ligados");

        		pisca_ativo = modo_pisca;

        		xTaskCreatePinnedToCore( vTask_PISCAS, "Task Piscas", 4096, (void*) modo_pisca, 2, &xTaskPiscasHandle, 0);
        	}

        	else if (pisca_ativo != modo_pisca)
        	{

        		Serial.println("A eliminar Task Piscas");

        		digitalWrite(LED_LEFT, LOW);
        		digitalWrite(LED_RIGHT, LOW);

        		pisca_ativo = modo_pisca;

        		vTaskDelete(xTaskPiscasHandle);

        		xTaskPiscasHandle = NULL;

        		xTaskCreatePinnedToCore( vTask_PISCAS, "Task Piscas", 4096, (void*)modo_pisca, 2, &xTaskPiscasHandle, 0);
        	}

        	else if (xTaskPiscasHandle != NULL && uxSemaphoreGetCount(xCountingSemaphore) == 0 && pisca_ativo != 4)
        	{

        		Serial.println("A eliminar Task Piscas");

        		digitalWrite(LED_LEFT, LOW);
        		digitalWrite(LED_RIGHT, LOW);

        		pisca_ativo = -1;

        		vTaskDelete(xTaskPiscasHandle);

        		xTaskPiscasHandle = NULL;
        	}
        }

        else
        {

        	if (xTaskPiscasHandle != NULL)
        	{

        		if (pisca_ativo == 0 || pisca_ativo == 1)
        		{

        			Serial.println("A eliminar Task Piscas");

        			digitalWrite(LED_LEFT, LOW);
        			digitalWrite(LED_RIGHT, LOW);

        			pisca_ativo = -1;

        			vTaskDelete(xTaskPiscasHandle);

        			xTaskPiscasHandle = NULL;
        		}

        		else if (pisca_ativo == 2 || pisca_ativo == 3)
        		{

        			if (uxSemaphoreGetCount(xCountingSemaphore) == 0)
        			{

        				Serial.println("A eliminar Task Piscas");

        				digitalWrite(LED_LEFT, LOW);
        				digitalWrite(LED_RIGHT, LOW);

        				pisca_ativo = -1;

        				vTaskDelete(xTaskPiscasHandle);

        				xTaskPiscasHandle = NULL;
        			}
        		}

        		else if (pisca_ativo == 4)
        		{

        			Serial.println("A eliminar Task Piscas");

        			digitalWrite(LED_LEFT, LOW);
        			digitalWrite(LED_RIGHT, LOW);

        			pisca_ativo = -1;

        			vTaskDelete(xTaskPiscasHandle);

        			xTaskPiscasHandle = NULL;
        		}
        	}
        }

        // Preencher a estrutura com o estado atual das luzes
        estadoEnviar.minimos = (xTaskMinimosHandle != NULL);
        estadoEnviar.medios = (xTaskMediosHandle != NULL);
        estadoEnviar.maximos = (xTaskMaximosHandle != NULL);
        estadoEnviar.pisca_esq = (pisca_ativo == 0 || pisca_ativo == 2);
        estadoEnviar.pisca_dir = (pisca_ativo == 1 || pisca_ativo == 3);
        estadoEnviar.quatro_piscas = (pisca_ativo == 4);

        // Enviar para a Queue o estado das luzes
        xQueueOverwrite(xQueue_Estado, &estadoEnviar);

        vTaskDelayUntil(&xLastWakeTime, ( 500 / portTICK_PERIOD_MS ));
    }
}


void vTask_LDR ( void *pvParameters )
{

    int valor_ldr = 1400;

    TickType_t xLastWakeTime;

    analogReadResolution(ADC_RESOLUTION);

	Serial.println("Task LDR a correr");

	// Leitura do valor de luminosidade
    for (;;)
    {

    	valor_ldr = analogRead(ADC_LDR);

        Serial.print("Valor LDR: ");
        Serial.println(valor_ldr);

        // Enviar para a Queue a luminosidade
        xQueueSendToBack(xQueue_LDR, &valor_ldr, xLastWakeTime);

        vTaskDelay( 1000 / portTICK_PERIOD_MS );
    }
}


void vTask_POT ( void *pvParameters )
{

	int valor_pot;
	int angulo_pot;

	TickType_t xLastWakeTime;

	analogReadResolution(ADC_RESOLUTION);

	Serial.println("Task Potenciometro a correr");

	// Leitura do ângulo do Volante
	for(;;)
		{

			valor_pot = analogRead(ADC_POT);
			angulo_pot = map(valor_pot, 0, 4095, -45, 45);

			Serial.print("Valor Potenciometro: ");
			Serial.println(valor_pot);
			Serial.print("Angulo Potenciometro: ");
			Serial.println(angulo_pot);

			// Enviar para as Queues o ângulo do volante
			xQueueOverwrite(xQueue_POT1, &angulo_pot);
			xQueueOverwrite(xQueue_POT2, &angulo_pot);

			vTaskDelay( 1000 / portTICK_PERIOD_MS );
		}
}


void vTask_SERVO ( void *pvParameters )
{

	int angulo_servo;

	Servo servo;

	TickType_t xLastWakeTime;

	servo.setPeriodHertz(50);
	servo.attach(SERVO_SIGNAL, 500, 2400);

	// Envia para o servo o ângulo que deve posicionar-se
	for (;;)
	{

		// Recebe da Queue o valor do ângulo do volante
		xQueueReceive(xQueue_POT1, &angulo_servo, 100);

		servo.write(angulo_servo + 90);

		vTaskDelay( 300 / portTICK_PERIOD_MS );
	}
}


void vTask_MINIMOS ( void *pvParameters )
{

	Serial.println("Task Minimos a correr");

	// Liga os Mínimos
	for(;;)
	{

		digitalWrite(LED_MIN, HIGH);

		vTaskDelay( 1000 / portTICK_PERIOD_MS );
	}

}


void vTask_MEDIOS ( void *pvParameters )
{

	Serial.println("Task Medios a correr");

	// Liga os Médios
	for(;;)
	{

		digitalWrite(LED_MED, HIGH);

		vTaskDelay( 1000 / portTICK_PERIOD_MS );
	}

}


void vTask_MAXIMOS ( void *pvParameters )
{

	Serial.println("Task Maximos a correr");

	// Liga os Máximos
	for(;;)
		{

			digitalWrite(LED_MAX, HIGH);

			vTaskDelay( 50 / portTICK_PERIOD_MS );
		}
}


void vTask_PISCAS ( void *pvParameters)
{

	int modo_pisca = (int)pvParameters;

	Serial.println("Task Piscas a correr");

	// Verifica qual o pisca acionado e pisca
	for(;;)
	{

		switch (modo_pisca)
		{

		case 0:

			Serial.println("Pisca Fixo Esquerdo");



				digitalWrite(LED_LEFT, HIGH);

				vTaskDelay(250 / portTICK_PERIOD_MS);

				digitalWrite(LED_LEFT, LOW);

				vTaskDelay(250 / portTICK_PERIOD_MS);


			break;

		case 1:

			Serial.println("Pisca Fixo Direito");



				digitalWrite(LED_RIGHT, HIGH);

				vTaskDelay(250 / portTICK_PERIOD_MS);

				digitalWrite(LED_RIGHT, LOW);

				vTaskDelay(250 / portTICK_PERIOD_MS);


			break;

		case 2:

			Serial.println("Pisca Temporario Esquerdo");

			if(xSemaphoreTake(xCountingSemaphore, 100 ) == pdTRUE)
		   	{

				digitalWrite(LED_LEFT, HIGH);

				vTaskDelay(250 / portTICK_PERIOD_MS);

				digitalWrite(LED_LEFT, LOW);

				vTaskDelay(250 / portTICK_PERIOD_MS);
		   	}

			break;

		case 3:

			Serial.println("Pisca Temporario Direito");

			if(xSemaphoreTake(xCountingSemaphore, 100 ) == pdTRUE)
		   	{

				digitalWrite(LED_RIGHT, HIGH);

				vTaskDelay(250 / portTICK_PERIOD_MS);

				digitalWrite(LED_RIGHT, LOW);

				vTaskDelay(250 / portTICK_PERIOD_MS);
		   	}

			break;

		case 4:

			Serial.println("4 Piscas");


			digitalWrite(LED_RIGHT, HIGH);
			digitalWrite(LED_LEFT, HIGH);

			vTaskDelay(250 / portTICK_PERIOD_MS);

			digitalWrite(LED_RIGHT, LOW);
			digitalWrite(LED_LEFT, LOW);

			vTaskDelay(250 / portTICK_PERIOD_MS);

			break;

		default:

			 Serial.println("Nenhum Pisca");
			 vTaskDelay(1000 / portTICK_PERIOD_MS);

			 break;
		}

		vTaskDelay(250 / portTICK_PERIOD_MS);
	}
}


void vTask_IDLE ( void *pvParameters )
{
	Serial.println("Task Idle a correr");

	for(;;)
			{

				vTaskDelay( 50 / portTICK_PERIOD_MS );
			}
}


static void IRAM_ATTR vExampleInterruptHandler( void )
{
static portBASE_TYPE xHigherPriorityTaskWoken;

  xHigherPriorityTaskWoken = pdFALSE;

  /* 'Give' the semaphore multiple times.  The first will unblock the handler
  task, the following 'gives' are to demonstrate that the semaphore latches
  the events to allow the handler task to process them in turn without any
  events getting lost.  This simulates multiple interrupts being taken by the
  processor, even though in this case the events are simulated within a single
  interrupt occurrence.*/
  xSemaphoreGiveFromISR( xCountingSemaphore, (BaseType_t*)&xHigherPriorityTaskWoken );
  xSemaphoreGiveFromISR( xCountingSemaphore, (BaseType_t*)&xHigherPriorityTaskWoken );
  xSemaphoreGiveFromISR( xCountingSemaphore, (BaseType_t*)&xHigherPriorityTaskWoken );
  xSemaphoreGiveFromISR( xCountingSemaphore, (BaseType_t*)&xHigherPriorityTaskWoken );
  xSemaphoreGiveFromISR( xCountingSemaphore, (BaseType_t*)&xHigherPriorityTaskWoken );

  if( xHigherPriorityTaskWoken == pdTRUE )
  {
    /* Giving the semaphore unblocked a task, and the priority of the
    unblocked task is higher than the currently running task - force
    a context switch to ensure that the interrupt returns directly to
    the unblocked (higher priority) task.

    NOTE: The syntax for forcing a context switch is different depending
    on the port being used.  Refer to the examples for the port you are
    using for the correct method to use! */
    //portYIELD_FROM_ISR();
    vPortYield();
  }
}


void loop()
{

	vTaskDelete(NULL);
}
